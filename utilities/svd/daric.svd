# Daric register map
Vendor: Daric; Series: Daric; File version: 1.0
Daric ARM Cortex-M7 Microcontroller
CPU: CM7 r1p2, little endian, MPU, FPU, vendor SysTick, 3 interrupt priority bits
Registers are 32-bit, access not given, reset 0x0 unless marked. A register's access mark holds for its fields unless they carry their own. Offsets are from the block's base; lines under a group give offsets from that group; [hi:lo] are bit positions; {n}, {i} and the like mark numbered series; 'fields as' and 'values as' point back to an identical list; <NAME> marks a mode.

## Memory map
0x40010000 QFC size 0x1000 — Quad Flash Controller
0x40011000 MDMA size 0x2000 — Direct Memory Access Controller
0x40040000 CGU size 0x80 — Clock Generation Unit
0x40040080 RCU size 0x10 — Reset Controller Unit
0x40040090 IPC size 0x70 — IP Control (PLL)
0x40041000 WDT size 0x1000 — Watchdog Timer
0x40042000 DUART size 0x1000 — Debug UART
0x40043000 ATIMER size 0x1000 — Advanced Timer
0x40044000 EVC size 0x1000 — Event Controller
0x40060000 PMU size 0x1000 — Power Management Unit & Always-On Domain Control
0x40061000 RTC size 0x1000 — Real Time Clock
0x40062000 WDT_AO size 0x1000
0x40063000 ATIMER_AO size 0x1000
0x40064000 KPC size 0x1000 — Keypad Controller
0x50101000 UART0 size 0x1000 — UART0 Interface
0x50102000 UART1 size 0x1000
0x50103000 UART2 size 0x1000
0x50104000 UART3 size 0x1000
0x50105000 SPIM0 size 0x1000 — SPI Master 0
0x50106000 SPIM1 size 0x1000
0x50107000 SPIM2 size 0x1000
0x50108000 SPIM3 size 0x1000
0x50109000 I2C0 size 0x1000 — I2C Master 0
0x5010A000 I2C1 size 0x1000
0x5010B000 I2C2 size 0x1000
0x5010C000 I2C3 size 0x1000
0x50120000 PWM size 0x1000 — Pulse Width Modulation
0x5012F000 GPIO size 0x1000 — General Purpose I/O
0x50202400 USB size 0x1000 — USB Controller

## Interrupts
16 QFC
30 AO_ATIMER (ATIMER_AO)
30 AO_WDT (WDT_AO)
30 KPC
30 RTC
64 UART0_RX (UART0) — UART0 RX Interrupt
65 UART0_TX (UART0) — UART0 TX Interrupt
66 UART0_RX_CHAR (UART0) — UART0 RX Char Interrupt
67 UART0_ERR (UART0) — UART0 Error Interrupt
68 UART1_RX (UART1)
69 UART1_TX (UART1)
70 UART1_RX_CHAR (UART1)
71 UART1_ERR (UART1)
72 UART2_RX (UART2)
73 UART2_TX (UART2)
74 UART2_RX_CHAR (UART2)
75 UART2_ERR (UART2)
76 UART3_RX (UART3)
77 UART3_TX (UART3)
78 UART3_RX_CHAR (UART3)
79 UART3_ERR (UART3)
80 SPIM0_RX (SPIM0)
81 SPIM0_TX (SPIM0)
82 SPIM0_CMD (SPIM0)
83 SPIM0_EOT (SPIM0)
84 SPIM1_RX (SPIM1)
85 SPIM1_TX (SPIM1)
86 SPIM1_CMD (SPIM1)
87 SPIM1_EOT (SPIM1)
88 SPIM2_RX (SPIM2)
89 SPIM2_TX (SPIM2)
90 SPIM2_CMD (SPIM2)
91 SPIM2_EOT (SPIM2)
92 SPIM3_RX (SPIM3)
93 SPIM3_TX (SPIM3)
94 SPIM3_CMD (SPIM3)
95 SPIM3_EOT (SPIM3)
96 I2C0_RX (I2C0)
97 I2C0_TX (I2C0)
98 I2C0_CMD (I2C0)
99 I2C0_EOT (I2C0)
100 I2C1_RX (I2C1)
101 I2C1_TX (I2C1)
102 I2C1_CMD (I2C1)
103 I2C1_EOT (I2C1)
104 I2C2_RX (I2C2)
105 I2C2_TX (I2C2)
106 I2C2_CMD (I2C2)
107 I2C2_EOT (I2C2)
108 I2C3_RX (I2C3)
109 I2C3_TX (I2C3)
110 I2C3_CMD (I2C3)
111 I2C3_EOT (I2C3)
140 PWM_T0 (PWM)
141 PWM_T1 (PWM)
142 PWM_T2 (PWM)
143 PWM_T3 (PWM)
144 GPIO
145 USB
184 I2C0_NACK (I2C0)
185 I2C1_NACK (I2C1)
186 I2C2_NACK (I2C2)
187 I2C3_NACK (I2C3)
188 I2C0_ERR (I2C0)
189 I2C1_ERR (I2C1)
190 I2C2_ERR (I2C2)
191 I2C3_ERR (I2C3)

## MDMA — Direct Memory Access Controller
Base 0x40011000
0x00 DMA_STAT ro — DMA status
0x04 DMA_CFG wo — DMA configuration
0x08 DMA_CTRL_BASE_PTR — Channel control data base pointer
0x0C DMA_ALT_BASE_PTR ro — Channel alternate control data base pointer
0x10 DMA_CH_WREQ_STAT ro — Channel wait on request status
0x14 DMA_CH_SW_REQ wo — Channel software request
0x20 DMA_CH_REQMASK_SET — Channel request mask set
0x24 DMA_CH_REQMASK_CLR wo — Channel request mask clear
0x28 DMA_CH_ENSET — Channel enable set
0x2C DMA_CH_ENCLR wo — Channel enable clear
0x30 DMA_CHPRIALT_SET — Channel primary-alternate set
0x34 DMA_CHPRIALT_CLR wo — Channel primary-alternate clear
0x38 DMA_CH_PRIO_SET — Channel priority set
0x3C DMA_CH_PRIO_CLR wo — Channel priority clear
{0x1000+4i} DMA_CHEVSEL[{i}] (i=0..7) — Event Selection for Channels
{0x1020+4i} DMA_CH_REQ[{i}] (i=0..7) — DMA Request Function Enable
{0x1040+4i} DMA_CH_SR_REQ[{i}] (i=0..7) ro — DMA Request Status

## Licence text in the file
Copyright 2024 CrossBar, Inc.
